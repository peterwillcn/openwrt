## defconfig/opir2s_defconfig
```kconfig
CONFIG_TARGET_ky=y
CONFIG_TARGET_ky_riscv64=y
CONFIG_TARGET_ky_riscv64_DEVICE_x1_orangepi-r2s=y
CONFIG_TARGET_KERNEL_PARTSIZE=100
CONFIG_TARGET_ROOTFS_PARTSIZE=400

CONFIG_DEVEL=y
CONFIG_KERNEL_CFLAGS="-Wno-vla"
CONFIG_KERNEL_DEVTMPFS=y

CONFIG_PACKAGE_blkid=y
CONFIG_PACKAGE_curl=y
# CONFIG_PACKAGE_dnsmasq is not set
CONFIG_PACKAGE_dnsmasq-full=y
CONFIG_PACKAGE_ethtool=y
CONFIG_PACKAGE_htop=y
CONFIG_PACKAGE_lm-sensors-detect=y
CONFIG_PACKAGE_lsblk=y
CONFIG_PACKAGE_nano=y
CONFIG_PACKAGE_tcpdump=y
CONFIG_PACKAGE_usbutils=y
CONFIG_PACKAGE_wget=y
```

## package/boot/uboot-rockchip/src/board/rockchip/nanopi_r76s/Kconfig
```kconfig
config SYS_BOARD
	default "nanopi_r76s"

config SYS_VENDOR
	default "rockchip"

config SYS_CONFIG_NAME
	default "nanopi_r76s"

config BOARD_SPECIFIC_OPTIONS
	def_bool y
```
